## Kconfig
```kconfig
mainmenu "ReliefOS System Configuration"

comment "Kernel configuration is owned by ReliefNT"
comment "Build policy: PROFILE=debug|release; V=1"

menu "System images"

config VMDK_DEFAULT_LANG
    string "Default system locale"
    default "zh_CN.UTF-8"
    help
      Locale written into /etc/reliefos/locale.conf of system images.
      Use an installed locale; C.UTF-8 does not enable gettext translations.

config IMAGE_SIZE_MIB
    int "Minimum standalone disk size in MiB (GPT, BIOS Boot, ESP and ext4)"
    range 384 4096
    default 1024
    help
      Minimum size requested by the BIOS/UEFI disk-image builder. The builder
      may increase it to fit the root filesystem and partition overhead.

config INSTALLER_ROOT_SIZE_MIB
    int "Minimum installer runtime root size in MiB"
    range 32 4096
    default 400
    help
      GRUB loads the complete installer root as a Multiboot module. It consumes
      guest RAM before userspace starts; the image builder may enlarge it to
      fit the runtime. Use sufficient guest RAM (normally at least 2 GiB).

menu "Legacy framebuffer appearance"

comment "XDM and IceWM use their own settings and themes"

choice
    prompt "Legacy framebuffer theme"
    default VMDK_DEFAULT_THEME_METRO
    help
      Controls /etc/reliefos/display.conf for retained framebuffer programs.
      This does not change the XDM login screen or the IceWM desktop theme.

config VMDK_DEFAULT_THEME_METRO
    bool "Metro"

config VMDK_DEFAULT_THEME_WIN95
    bool "Win95"

endchoice

choice
    prompt "Legacy framebuffer wallpaper mode"
    default VMDK_WALLPAPER_FILL

config VMDK_WALLPAPER_FILL
    bool "Fill"

config VMDK_WALLPAPER_STRETCH
    bool "Stretch"

config VMDK_WALLPAPER_CENTER
    bool "Center"

endchoice

endmenu
endmenu

menu "Activation policy"

config VMDK_REQUIRE_LICENSE
    bool "Require activation in standalone images"
    default y
    help
      Compile the standalone userspace activation policy. This is separate
      from the policy compiled for systems deployed by the installer.

config INSTALLER_INSTALLED_REQUIRE_LICENSE
    bool "Require activation in installer-deployed systems"
    default y
    help
      Compile the activation policy used by the installed-system payload.
      This does not select the standalone-image policy above.

config LICENSE_SERVER_URL
    string "Activation service URL"
    default "http://127.0.0.1:30301"

config LICENSE_DEBUG_LOG
    bool "Activation diagnostic logging"
    default y

endmenu

menu "Package repository"

config RPR_BASE_URL
    string "ReliefOS remote package repository URL"
    default "https://reliefosproject.github.io/ReliefOS/rpr"
    help
      Base URL of the RPR subtree. Clients append /apk for signed package
      metadata and /kernel for kernel releases. It is not the documentation
      URL or the complete Pages site root.

endmenu

source "Kconfig.components"

menu "QEMU run targets"

config QEMU_MEMORY_MB
    int "Guest memory in MiB"
    range 128 65536
    default 4096
    help
      Default for run, run-iso and run-installer; MEMORY overrides it.
      Small values may be insufficient for the selected boot media.

config QEMU_SMP_CPUS
    int "Virtual CPU count"
    range 1 64
    default 4
    help
      Default for run targets. CPUS overrides it; this does not configure
      or limit the number of CPUs supported by the kernel.

config QEMU_DISPLAY_WIDTH
    int "VGA display width"
    range 640 7680
    default 1920

config QEMU_DISPLAY_HEIGHT
    int "VGA display height"
    range 480 4320
    default 1080

config QEMU_ENABLE_KVM
    bool "Use KVM acceleration"
    default y
    help
      Requires usable KVM on the host. QEMU_KVM=0 selects software emulation.

config QEMU_NET_DEVICE
    string "Network device model (empty disables networking)"
    default "e1000"

config QEMU_OVMF_PATH
    string "Preferred OVMF firmware path for UEFI"
    default "/usr/share/ovmf/OVMF.fd"
    help
      An existing file takes priority over automatic OVMF discovery.
      QEMU_BOOT=bios uses SeaBIOS and does not use this firmware path.

endmenu
```
